## drivers/chronos_csi/Kconfig
```kconfig
# SPDX-License-Identifier: GPL-2.0-only

config VIDEO_CHRONOS_CSI
	tristate "Chronos aggregated CSI-2 bridge subdevice"
	depends on VIDEO_DEV && OF
	depends on CHRONOS_FPGA
	select MEDIA_CONTROLLER
	select VIDEO_V4L2_SUBDEV_API
	help
	  V4L2 subdevice bridge for the Chronos multi-camera board.  The
	  board's CrossLink-NX FPGA aggregates four OV9281 cameras into one
	  2-lane MIPI CSI-2 link with virtual channels VC0..VC3; this subdev
	  represents that single aggregated source toward the Tegra
	  NVCSI/VI capture stack (which creates the video nodes).

	  Requires the chronos_fpga control driver for the FSIN trigger
	  start/stop path.

	  To compile this driver as a module, choose M here: the module
	  will be called chronos_csi.
```

## drivers/chronos_fpga/Kconfig
```kconfig
# SPDX-License-Identifier: GPL-2.0-only

config CHRONOS_FPGA
	tristate "Chronos FPGA control interface"
	depends on I2C && OF
	select REGMAP_I2C
	help
	  Driver for the I2C control interface of the Lattice CrossLink-NX
	  FPGA on the Chronos multi-camera board (7-bit address 0x3C,
	  compatible "chronos,fpga-ctrl").

	  The FPGA aggregates four OV9281 cameras into one 2-lane MIPI CSI-2
	  link with virtual channels VC0..VC3 and generates the FSIN frame
	  trigger.  This driver exposes trigger/frame-rate/status control via
	  sysfs and an in-kernel API used by the chronos_csi bridge.

	  To compile this driver as a module, choose M here: the module
	  will be called chronos_fpga.
```

## drivers/ov9281/Kconfig
```kconfig
# SPDX-License-Identifier: GPL-2.0-only

config VIDEO_OV9281
	tristate "OmniVision OV9281 sensor support (NOT for the Chronos board)"
	depends on I2C && VIDEO_DEV
	select MEDIA_CONTROLLER
	select VIDEO_V4L2_SUBDEV_API
	select V4L2_FWNODE
	help
	  This is a V4L2 sensor driver for the OmniVision OV9281
	  global shutter camera sensor, for setups where the sensor is
	  directly attached to the host's I2C bus and MIPI receiver.

	  DO NOT enable or load this driver on the Chronos board
	  (HW_CHRONOS_R1): there the OV9281 sensors live on FPGA-private
	  SCCB buses that the Jetson cannot reach, and the FPGA owns the
	  complete sensor configuration (27 MHz XCLK, FSIN trigger mode,
	  30 fps).  This driver's 24 MHz / 120 fps free-run defaults
	  conflict with that.  Use CHRONOS_FPGA and VIDEO_CHRONOS_CSI
	  instead.  It is kept only as a reference for a future hardware
	  revision.

	  To compile this driver as a module, choose M here: the
	  module will be called ov9281.
```
